## kernel/linux/arch/arm/mach-mx28/Kconfig
```kconfig
choice
	prompt "Select i.MXS board type"

config MACH_MX28EVK
	bool "Freescale MX28 EVK board"
	depends on ARCH_MX28
	select USB_ARCH_HAS_EHCI

endchoice

choice
	prompt "Select i.MXS 283/280/287platform"

config iMX_283
	bool "enable iMX283"
	depends on ARCH_MX28
	select USB_ARCH_HAS_EHCI
	default y

config iMX_280
	bool "enable iMX280"
	depends on ARCH_MX28
	select USB_ARCH_HAS_EHCI

config iMX_287
	bool "enable iMX287"
	depends on ARCH_MX28
	select USB_ARCH_HAS_EHCI


endchoice


config VECTORS_PHY_ADDR
	int "vectors address"
	default 0
	help
	  This config set vectors table is located which physical address

config MXS_TIMER_WITH_MACH
	bool "System Timer support Compare Match interrupt"
	default y

config MEM_mDDR
	bool "Memory type is mDDR"
	depends on ARCH_MX28
	help
	  Say Y to select mDDR memory
```
